
#include <M5Unified.h>
#include <Wire.h>


#include "mruby_init.h"

/***************** */
//   for new fonts

#define FONT_IMPORT(name) \
extern "C" { extern const uint8_t name[]; } \
const lgfx::U8g2font lgfx_##name = {name}; 

FONT_IMPORT(misaki_8)   // import misaki_8 as lgfx_misaki_8
FONT_IMPORT(misakig_8)
FONT_IMPORT(k8x12)
FONT_IMPORT(shnmk12)
//FONT_IMPORT(elisa10)
//FONT_IMPORT(elisa10p)
//FONT_IMPORT(mplus_j10)
//FONT_IMPORT(elisa10t)
//FONT_IMPORT(elisa10e)
//FONT_IMPORT(elisa10l)

void register_fonts(){
  /*  for M5Unified fonts*/
//  c_font_add("efontJA_10", &fonts::efontJA_10);
  c_font_add("japanGothic_8", &fonts::lgfxJapanGothic_8);

// converted fonts
  c_font_add("misaki_8", &lgfx_misaki_8);
  c_font_add("misakig_8", &lgfx_misakig_8);
  c_font_add("k8x12", &lgfx_k8x12);
  c_font_add("shnmk12", &lgfx_shnmk12);
//  c_font_add("mplus_j10", &lgfx_mplus_j10);
//  c_font_add("elisa10", &lgfx_elisa10);
//  c_font_add("elisa10p", &lgfx_elisa10p);
// c_font_add("elisa10t", &lgfx_elisa10t);
//  c_font_add("elisa10e", &lgfx_elisa10e);
//  c_font_add("elisa10l", &lgfx_elisa10l);

}
/***************** */


#define mrubycode test // codename generated by mrbc from demo.rb

#define MEMSIZE (1024*50)
static uint8_t mempool[MEMSIZE];
extern const uint8_t mrubycode[];

static struct VM *vm;
unsigned char buff[10*1024];
int buff_ptr=0;

void show_exception_screen(){
  M5.Lcd.fillScreen(TFT_RED);
  int w = M5.Lcd.width();
  int h = M5.Lcd.height();
  int sz=(w>200)? 2 : 1;
  for(int i=4; i<18*sz; i++){
    M5.Lcd.fillRect(0, h/2-i, w, i*2, TFT_BLACK);
    M5.Lcd.drawRect(0, h/2-i+2, w, i*2-4, TFT_YELLOW);
    M5.Display.waitDisplay();
  }
  M5.Lcd.setTextSize(sz);
  M5.Lcd.setFont(nullptr);
  M5.Lcd.setCursor(w/2-26*sz, h/2-12*sz);
  M5.Lcd.setTextColor(TFT_YELLOW);
  M5.Lcd.println("EXCEPTION");
  M5.Lcd.setTextColor(TFT_WHITE);
  M5.Lcd.setCursor(w/2-30*sz, M5.Lcd.getCursorY());
  M5.Lcd.println("See Serial.");
  M5.Lcd.setCursor(w/2-38*sz, M5.Lcd.getCursorY());
  M5.Lcd.println("Press to exit");
  delay(500);
  M5.update(); M5.update(); //clear touch count
  while(M5.Touch.getCount()==0 || M5.BtnA.wasPressed()){
    delay(100);
    M5.update();
  }
}


void setup() {
  auto cfg = M5.config();
  M5.begin(cfg);
  M5.Display.setTextSize(2);

  Wire.begin(); // for cardkb
  M5.Log.println("start");

  mrbc_init(mempool, MEMSIZE);
  my_mrubyc_init();
  register_fonts();

}

void loop(){
  auto tcb = mrbc_create_task( mrubycode, 0 );
  if(NULL == tcb){
    M5.Display.print("setup error");
    M5.Log.println("mrbc_create_task error");  // may not be printed
    return;
  }
  int ret = mrbc_run();
  if(ret == 2 && M5.getBoard()<lgfx::boards::board_M5AtomLite){
    show_exception_screen();
  }
  mrbc_delete_task(tcb);
  M5.Log.println("mrbc done");

  ESP.restart();
}
